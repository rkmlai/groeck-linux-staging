## Documentation/devicetree/bindings/watchdog/fsl-imx-wdt.txt
```
* Freescale i.MX Watchdog Timer (WDT) Controller

Required properties:
- compatible : Should be "fsl,<soc>-wdt"
- reg : Should contain WDT registers location and length
- interrupts : Should contain WDT interrupt

Optional property:
- big-endian: Boolean property, required if all the i.MX WDT registers
  are big-endian rather than little-endian.

Examples:

wdt@73f98000 {
	compatible = "fsl,imx51-wdt", "fsl,imx21-wdt";
	reg = <0x73f98000 0x4000>;
	interrupts = <58>;
	big-endian;
};
```
